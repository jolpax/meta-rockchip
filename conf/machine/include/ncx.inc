## conf/machine/include/ncx.inc
```bitbake
KERNEL_RELEASE              ?= "NULL"
RKBIN_RELEASE               ?= "NULL"
TOOLS_RELEASE               ?= "NULL"
UBOOT_RELEASE               ?= "NULL"
RKWIFIBT_RELEASE            ?= "NULL"
ALSAS_CONFIG_RELEASE        ?= "NULL"
GSTREAMER_ROCKCHIP_RELEASE  ?= "NULL"
MPP_RELEASE                 ?= "NULL"
CAMERA_ENGINE_RKISP         ?= "NULL"
CAMERA_ENGINE_RKAIQ         ?= "NULL"
LINUX_RGA                   ?= "NULL"
LIBMALI                     ?= "NULL"
```

## conf/machine/ncx-rk3568.conf
```bitbake
# Copyright (c) 2020, Rockchip Electronics Co., Ltd
# Released under the MIT license (see COPYING.MIT for the terms)

#@TYPE: Machine
#@RK_PRODUCT_MODEL: ROC_RK3566_PC

require conf/machine/include/rk356x.inc
require conf/machine/include/ncx.inc

KBUILD_DEFCONFIG = "ncx_linux_defconfig"
KERNEL_DEVICETREE = "rockchip/rk3568-ncx.dtb"

UBOOT_MACHINE = "ncx-rk3568_defconfig"

RK_WIFIBT_FIRMWARES = " \
	rkwifibt-firmware-ap6398s-wifi \
	rkwifibt-firmware-ap6398s-bt \
	brcm-tools \
"

MACHINE_EXTRA_RRECOMMENDS:append = " \
	drm-cursor \
"
```
